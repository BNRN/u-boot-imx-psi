## board/psicontrol/hotraco_hrfocus_spl/Kconfig
```kconfig
if TARGET_HOTRACO_HRFOCUS_SPL

config SYS_CPU
	string
	default "armv7"

config SYS_BOARD
	string
	default "hotraco_hrfocus_spl"

config SYS_VENDOR
	string
	default "psicontrol"

config SYS_SOC
	string
	default "mx6"

config SYS_CONFIG_NAME
	string
	default "hotraco_hrfocus_spl"

endif
```

## board/psicontrol/petersime_ihmi/Kconfig
```kconfig
if TARGET_PETERSIME_IHMI

config SYS_CPU
	default "armv7"

config SYS_BOARD
	default "petersime_ihmi"

config SYS_VENDOR
	default "psicontrol"

config SYS_SOC
	default "mx6"

config SYS_CONFIG_NAME
	default "petersime_ihmi"

endif
```

## board/psicontrol/verkerk_vipbox-III/Kconfig
```kconfig
if TARGET_VERKERK_VIPBOX_III

config SYS_CPU
	default "armv7"

config SYS_BOARD
	default "verkerk_vipbox-III"

config SYS_VENDOR
	default "psicontrol"

config SYS_SOC
	default "mx6"

config SYS_CONFIG_NAME
	default "verkerk_vipbox-III"

endif
```

## board/psicontrol/verkerk_vipbox-III_spl/Kconfig
```kconfig
if TARGET_VERKERK_VIPBOX_III_SPL

config SYS_CPU
	default "armv7"

config SYS_BOARD
	default "verkerk_vipbox-III_spl"

config SYS_VENDOR
	default "psicontrol"

config SYS_SOC
	default "mx6"

config SYS_CONFIG_NAME
	default "verkerk_vipbox-III_spl"

endif
```

## configs/hotraco_hrfocus_spl_defconfig
```kconfig
CONFIG_SPL=y
CONFIG_LOCALVERSION_AUTO=n
CONFIG_SYS_EXTRA_OPTIONS="IMX_CONFIG=board/psicontrol/hotraco_hrfocus_spl/hotraco_hrfocus.cfg,MX6S,DDR_MB=1024,SPL"
+S:CONFIG_ARM=y
+S:CONFIG_TARGET_HOTRACO_HRFOCUS_SPL=y
```

## configs/petersime_ihmi_defconfig
```kconfig
CONFIG_SYS_EXTRA_OPTIONS="IMX_CONFIG=board/psicontrol/petersime_ihmi/petersime_ihmi.cfg,MX6S,PETERSIME_IHMI,DDR_MB=1024"
CONFIG_ARM=y
CONFIG_TARGET_PETERSIME_IHMI=y
CONFIG_LOCALVERSION_AUTO=n
CONFIG_LOCALVERSION=": psiversion: 14081.0.0.1"
```

## configs/petersime_ihmi_spl_defconfig
```kconfig
CONFIG_SPL=y
CONFIG_SYS_EXTRA_OPTIONS="IMX_CONFIG=board/psicontrol/petersime_ihmi_spl/petersime_ihmi.cfg,MX6S,DDR_MB=1024,SPL"
+S:CONFIG_ARM=y
+S:CONFIG_TARGET_PETERSIME_IHMI_SPL=y
```

## configs/verkerk_vipbox-III_defconfig
```kconfig
CONFIG_SYS_EXTRA_OPTIONS="IMX_CONFIG=board/psicontrol/verkerk_vipbox-III/verkerk_vipbox-III.cfg,MX6S,VERKERK_VIPBOX_III,DDR_MB=1024"
CONFIG_ARM=y
CONFIG_TARGET_VERKERK_VIPBOX_III=y
CONFIG_LOCALVERSION_AUTO=n
CONFIG_LOCALVERSION="15004.0.0.1"
```

## configs/verkerk_vipbox-III_spl_defconfig
```kconfig
CONFIG_SPL=y
CONFIG_LOCALVERSION_AUTO=n
CONFIG_SYS_EXTRA_OPTIONS="IMX_CONFIG=board/psicontrol/verkerk_vipbox-III_spl/verkerk_vipbox-III.cfg,MX6S,DDR_MB=1024,SPL"
+S:CONFIG_ARM=y
+S:CONFIG_TARGET_VERKERK_VIPBOX_III_SPL=y
```
